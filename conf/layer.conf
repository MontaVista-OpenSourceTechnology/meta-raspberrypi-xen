## conf/layer.conf
```bitbake
# We have a conf and classes directory, add to BBPATH
BBPATH .= ":${LAYERDIR}"

# We have recipes-* directories, add to BBFILES
BBFILES += "${LAYERDIR}/recipes-*/*/*.bb \
            ${LAYERDIR}/recipes-*/*/*.bbappend"

BBFILE_COLLECTIONS += "raspberrypi-xen"
BBFILE_PATTERN_raspberrypi-xen = "^${LAYERDIR}/"
BBFILE_PRIORITY_raspberrypi-xen = "6"

LAYERDEPENDS_raspberrypi-xen = "core raspberrypi virtualization-layer"
LAYERSERIES_COMPAT_raspberrypi-xen = "dunfell"
```

## conf/machine/raspberrypi4-64-xen.conf
```bitbake
require conf/machine/raspberrypi4-64.conf
require conf/machine/include/rpixen.inc

# Still do normal pi4-64 things.
MACHINEOVERRIDES .= ":raspberrypi4-64"
```

## conf/machine/rpixen.inc
```bitbake
# Install Xen in the rpi root filesystem.
FATPAYLOAD += "/boot/xen"

# Xen dom0 console.
KERNEL_CONSOLE = "hvc0"
SERIAL_CONSOLES = "115200;hvc0"

# Xen uses u-boot for configuration and uses the uart.
RPI_USE_U_BOOT = "1"
ENABLE_UART = "1"

# Make sure the Xen tools and xen are on the dom0 target
MACHINE_ESSENTIAL_EXTRA_RRECOMMENDS = "packagegroup-xen-dom0"

# We use this to only do certain things when we are using a Xen machine.
MACHINEOVERRIDES .= ":rpixen"
```
